/**
 * @cliArgs --board "/ti/boards/MSP_EXP432P401R" --product "simplelink_msp432p4_sdk@3.40.01.02"
 * @versions {"data":"2021040816","timestamp":"2021040816","tool":"1.8.1+1900","templates":null}
 */

/**
 * Import the modules used in this configuration.
 */
const Display  = scripting.addModule("/ti/display/Display", {}, false);
const Display1 = Display.addInstance();
const GPIO     = scripting.addModule("/ti/drivers/GPIO");
const RTOS     = scripting.addModule("/ti/drivers/RTOS");
const Button   = scripting.addModule("/ti/drivers/apps/Button", {}, false);
const Button1  = Button.addInstance();
const Button2  = Button.addInstance();
const LED      = scripting.addModule("/ti/drivers/apps/LED", {}, false);
const LED1     = LED.addInstance();
const LED2     = LED.addInstance();
const LED3     = LED.addInstance();
const LED4     = LED.addInstance();

/**
 * Write custom configuration values to the imported modules.
 */
Display1.$hardware  = system.deviceData.board.components.XDS110UART;
Display1.$name      = "PC_UART_Display";
Display1.uart.$name = "PC_UART";

const Power                   = scripting.addModule("/ti/drivers/Power", {}, false);
Power.performanceLevel3.$name = "ti_drivers_power_PowerMSP432PerfLevels0";
Power.performanceLevel2.$name = "ti_drivers_power_PowerMSP432PerfLevels1";
Power.performanceLevel1.$name = "ti_drivers_power_PowerMSP432PerfLevels2";
Power.performanceLevel0.$name = "ti_drivers_power_PowerMSP432PerfLevels3";


Button1.$name                    = "BUTTON_LEFT";
Button1.$hardware                = system.deviceData.board.components.S1;
Button1.gpioPin.callbackFunction = "LeftButtonCallback";
Button1.gpioPin.$name            = "BUTTON_LEFT_GPIO";

Button2.$name                    = "BUTTON_RIGHT";
Button2.$hardware                = system.deviceData.board.components.S2;
Button2.gpioPin.callbackFunction = "RightButtonCallback";
Button2.gpioPin.$name            = "BUTTON_RIGHT_GPIO";

LED1.$name     = "SINGLE_RED";
LED1.$hardware = system.deviceData.board.components.LED1_RED;

LED2.$hardware = system.deviceData.board.components.LED2_RED;
LED2.$name     = "RGB_RED";
LED2.dimmable  = true;

LED3.$name     = "RGB_GREEN";
LED3.$hardware = system.deviceData.board.components.LED2_GREEN;
LED3.dimmable  = true;

LED4.$name     = "RGB_BLUE";
LED4.$hardware = system.deviceData.board.components.LED2_BLUE;
LED4.dimmable  = true;

/**
 * Pinmux solution for unlocked pins/peripherals. This ensures that minor changes to the automatic solver in a future
 * version of the tool will not impact the pinmux you originally saw.  These lines can be completely deleted in order to
 * re-solve from scratch.
 */
Display1.uart.uart.$suggestSolution       = "EUSCI_A0";
Display1.uart.uart.txPin.$suggestSolution = "7";
Display1.uart.uart.rxPin.$suggestSolution = "6";
RTOS.timer0.resource.$suggestSolution     = "Timer_A0";
Button1.gpioPin.gpioPin.$suggestSolution  = "5";
Button2.gpioPin.gpioPin.$suggestSolution  = "8";
LED1.gpioPin.gpioPin.$suggestSolution     = "4";
LED2.pwmPin.timer.$suggestSolution        = "Timer_A1";
LED2.pwmPin.timer.pwmPin.$suggestSolution = "16";
LED3.pwmPin.timer.$suggestSolution        = "Timer_A1";
LED3.pwmPin.timer.pwmPin.$suggestSolution = "17";
LED4.pwmPin.timer.$suggestSolution        = "Timer_A1";
LED4.pwmPin.timer.pwmPin.$suggestSolution = "18";
